## drivers/input/touchscreen/ft3518_i2c/Kconfig
```kconfig
#
# Focaltech Touchscreen driver configuration
#

config TOUCHSCREEN_FT3518_I2C
    bool "Focaltech Touchscreen"
    default y
    help
      Say Y here if you have Focaltech touch panel.
      If unsure, say N.
      
config TOUCHSCREEN_FT3518_I2C_DIRECTORY
    string "Focaltech ts directory name"
    default "focaltech_touch"
    depends on TOUCHSCREEN_FT3518_I2C
    
```
