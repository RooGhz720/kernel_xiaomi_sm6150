/* Copyright (c) 2019, The Linux Foundation. All rights reserved.
 * Copyright (C) 2021 XiaoMi, Inc.
 *
 * This program is free software; you can redistribute it and/or modify
 * it under the terms of the GNU General Public License version 2 and
 * only version 2 as published by the Free Software Foundation.
 *
 * This program is distributed in the hope that it will be useful,
 * but WITHOUT ANY WARRANTY; without even the implied warranty of
 * MERCHANTABILITY or FITNESS FOR A PARTICULAR PURPOSE.  See the
 * GNU General Public License for more details.
 */

/*---------------------------------------------------------------------------
 * This file is autogenerated file using gcdb parser. Please do not edit it.
 * Update input XML file to add a new entry or update variable in this file
 * VERSION = "1.0"
 *---------------------------------------------------------------------------*/
&soc {
	dsi_k6_38_0c_0a_fhd_dsc_video: qcom,mdss_dsi_k6_38_0c_0a_fhd_dsc_video {
		qcom,mdss-dsi-panel-name = "xiaomi k6 38 0c 0a fhd dsc video dsi panel";
	dsi_k6_38_0c_0a_fhd_dsc_video: qcom,mdss_dsi_k6_38_0c_0a_fhd_dsc_video {
		qcom,mdss-dsi-panel-name = "xiaomi k6 38 0c 0a fhd dsc video dsi panel";
		qcom,mdss-dsi-panel-id = <0>;
		qcom,mdss-dsi-panel-type = "dsi_video_mode";
		qcom,mdss-dsi-virtual-channel-id = <0>;
		qcom,mdss-dsi-stream = <0>;
							39 01 00 00 00 00 03 F0 5A 5A
					39 00 00 00 00 00 02 B0 0A
					39 00 00 00 00 00 02 EE 06
					39 00 00 00 00 00 02 B0 0B
					39 00 00 00 00 00 03 D8 59 70
					39 00 00 00 00 00 02 60 10
					39 00 00 00 00 00 03 FC 5A 5A
					39 00 00 00 00 00 02 B0 16
					39 00 00 00 00 00 02 D1 2E
					39 00 00 00 00 00 03 FC A5 A5
					39 01 00 00 00 00 02 53 28
					39 01 00 00 09 00 03 F0 A5 A5
				];
				qcom,mdss-dsi-nolp-command-state = "dsi_lp_mode";

				qcom,compression-mode = "dsc";
				qcom,mdss-dsc-slice-height = <8>;
				qcom,mdss-dsc-slice-width = <540>;
				qcom,mdss-dsc-slice-per-pkt = <2>;
				qcom,mdss-dsc-bit-per-component = <8>;
				qcom,mdss-dsc-bit-per-pixel = <8>;
				qcom,mdss-dsc-block-prediction-enable;
			};
		};
	};
};

&dsi_k11a_38_08_0a_dsc_cmd {
	mi,mdss-dsi-bl-dcs-big-endian-type;
	mi,feature-enabled;
	mi,mdss-dsi-panel-hbm-51-ctrl-flag;
	mi,mdss-dsi-panel-hbm-off-51-index = <1>;
	mi,esd-err-irq-gpio = <&tlmm 51 0x2001>;
	mi,mdss-panel-on-dimming-delay = <120>;
	mi,mdss-dsi-pan-enable-smart-fps;
	mi,mdss-dsi-smart-fps-max_framerate = <120>;
	mi,mdss-dsi-panel-hbm-brightness = <1>;
	mi,mdss-dsi-panel-dc-threshold = <440>;
	mi,mdss-dsi-panel-max-brightness-clone = <8191>;
	qcom,mdss-dsi-display-timings {
		timing@0{
			mi,mdss-dsi-dimmingon-command = [39 01 00 00 00 00 02 53 28];
			mi,mdss-dsi-dimmingon-command-state = "dsi_hs_mode";
			mi,mdss-dsi-dimmingoff-command = [39 01 00 00 00 00 02 53 20];
			mi,mdss-dsi-dimmingoff-command-state = "dsi_hs_mode";

			mi,mdss-dsi-hbm-on-command = [
				39 01 00 00 00 00 02 53 E8
				39 01 00 00 00 00 03 51 00 00
			];
			mi,mdss-dsi-hbm-off-command = [
				39 01 00 00 00 00 02 53 28
				39 01 00 00 00 00 03 51 07 FF
			];
			mi,mdss-dsi-hbm-on-command-state = "dsi_lp_mode";
			mi,mdss-dsi-hbm-off-command-state = "dsi_lp_mode";

			mi,mdss-dsi-doze-hbm-command = [
				05 01 00 00 00 00 02 28 00
				39 00 00 00 00 00 03 F0 5A 5A
				39 00 00 00 00 00 02 60 00
				39 00 00 00 00 00 03 FC 5A 5A
				39 00 00 00 00 00 02 B0 16
				39 00 00 00 00 00 02 D1 2E
				39 00 00 00 00 00 03 FC A5 A5
				39 00 00 00 00 00 02 B0 0B
				39 00 00 00 00 00 03 D8 50 00
				39 00 00 00 00 00 02 53 22
				39 01 00 00 22 00 03 F0 A5 A5
				05 01 00 00 00 00 02 29 00
			];
			mi,mdss-dsi-doze-lbm-command = [
				05 01 00 00 00 00 02 28 00
				39 00 00 00 00 00 03 F0 5A 5A
				39 00 00 00 00 00 02 60 00
				39 00 00 00 00 00 03 FC 5A 5A
				39 00 00 00 00 00 02 B0 16
				39 00 00 00 00 00 02 D1 2E
				39 00 00 00 00 00 03 FC A5 A5
				39 00 00 00 00 00 02 B0 0B
				39 00 00 00 00 00 03 D8 50 00
				39 00 00 00 00 00 02 53 23
				39 01 00 00 22 00 03 F0 A5 A5
				05 01 00 00 00 00 02 29 00
			];
			mi,mdss-dsi-doze-hbm-command-state = "dsi_lp_mode";
			mi,mdss-dsi-doze-lbm-command-state = "dsi_lp_mode";

			mi,mdss-dsi-flat-on-command = [
				39 00 00 00 00 00 03 F0 5A 5A
				39 00 00 00 00 00 03 C2 2D 27
				39 00 00 00 00 00 02 F7 03
				39 01 00 00 09 00 03 F0 A5 A5
			];
			mi,mdss-dsi-flat-off-command = [
				39 00 00 00 00 00 03 F0 5A 5A
				39 00 00 00 00 00 03 C2 2D 07
				39 00 00 00 00 00 02 F7 03
				39 01 00 00 09 00 03 F0 A5 A5
			];
			mi,mdss-dsi-flat-on-command-state = "dsi_lp_mode";
			mi,mdss-dsi-flat-off-command-state = "dsi_lp_mode";

			mi,mdss-dsi-crc-off-command = [
				/* CRC Disable (Normal mode) */
				39 01 00 00 00 00 02 81 00
				39 00 00 00 00 00 03 F0 5A 5A
				/* CRC Bypass */
				39 00 00 00 00 00 02 B1 01
				39 01 00 00 00 00 03 F0 A5 A5
			];
			mi,mdss-dsi-crc-off-command-state = "dsi_hs_mode";
		};
		timing@1{
			mi,mdss-dsi-dimmingon-command = [39 01 00 00 00 00 02 53 28];
			mi,mdss-dsi-dimmingon-command-state = "dsi_hs_mode";
			mi,mdss-dsi-dimmingoff-command = [39 01 00 00 00 00 02 53 20];
			mi,mdss-dsi-dimmingoff-command-state = "dsi_hs_mode";

			mi,mdss-dsi-hbm-on-command = [
				39 01 00 00 00 00 02 53 E8
				39 01 00 00 00 00 03 51 00 00
			];
			mi,mdss-dsi-hbm-off-command = [
				39 01 00 00 00 00 02 53 28
				39 01 00 00 00 00 03 51 07 FF
			];
			mi,mdss-dsi-hbm-on-command-state = "dsi_lp_mode";
			mi,mdss-dsi-hbm-off-command-state = "dsi_lp_mode";

			mi,mdss-dsi-doze-hbm-command = [
				05 01 00 00 00 00 02 28 00
				39 00 00 00 00 00 03 F0 5A 5A
				39 00 00 00 00 00 02 60 00
				39 00 00 00 00 00 03 FC 5A 5A
				39 00 00 00 00 00 02 B0 16
				39 00 00 00 00 00 02 D1 2E
				39 00 00 00 00 00 03 FC A5 A5
				39 00 00 00 00 00 02 B0 0B
				39 00 00 00 00 00 03 D8 50 00
				39 00 00 00 00 00 02 53 22
				39 01 00 00 22 00 03 F0 A5 A5
				05 01 00 00 00 00 02 29 00
			];
			mi,mdss-dsi-doze-lbm-command = [
				05 01 00 00 00 00 02 28 00
				39 00 00 00 00 00 03 F0 5A 5A
				39 00 00 00 00 00 02 60 00
				39 00 00 00 00 00 03 FC 5A 5A
				39 00 00 00 00 00 02 B0 16
				39 00 00 00 00 00 02 D1 2E
				39 00 00 00 00 00 03 FC A5 A5
				39 00 00 00 00 00 02 B0 0B
				39 00 00 00 00 00 03 D8 50 00
				39 00 00 00 00 00 02 53 23
				39 01 00 00 22 00 03 F0 A5 A5
				05 01 00 00 00 00 02 29 00
			];
			mi,mdss-dsi-doze-hbm-command-state = "dsi_lp_mode";
			mi,mdss-dsi-doze-lbm-command-state = "dsi_lp_mode";

			mi,mdss-dsi-flat-on-command = [
				39 00 00 00 00 00 03 F0 5A 5A
				39 00 00 00 00 00 03 C2 2D 27
				39 00 00 00 00 00 02 F7 03
				39 01 00 00 09 00 03 F0 A5 A5
			];
			mi,mdss-dsi-flat-off-command = [
				39 00 00 00 00 00 03 F0 5A 5A
				39 00 00 00 00 00 03 C2 2D 07
				39 00 00 00 00 00 02 F7 03
				39 01 00 00 09 00 03 F0 A5 A5
			];
			mi,mdss-dsi-flat-on-command-state = "dsi_lp_mode";
			mi,mdss-dsi-flat-off-command-state = "dsi_lp_mode";

			mi,mdss-dsi-crc-off-command = [
				/* CRC Disable (Normal mode) */
				39 01 00 00 00 00 02 81 00
				39 00 00 00 00 00 03 F0 5A 5A
				/* CRC Bypass */
				39 00 00 00 00 00 02 B1 01
				39 01 00 00 00 00 03 F0 A5 A5
			];
			mi,mdss-dsi-crc-off-command-state = "dsi_hs_mode";
		};
	};
};